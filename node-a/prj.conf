## CMakeLists.txt
```
# SPDX-License-Identifier: Apache-2.0

cmake_minimum_required(VERSION 3.13.1)
set(QEMU_EXTRA_FLAGS -s)

include($ENV{ZEPHYR_BASE}/cmake/app/boilerplate.cmake NO_POLICY_SCOPE)
project(mesh)

target_sources(app PRIVATE src/main.c src/app_prov.c)
```

## prj.conf
```kconfig
#CONFIG_INIT_STACKS=y
CONFIG_MAIN_STACK_SIZE=26200
CONFIG_SYSTEM_WORKQUEUE_STACK_SIZE=10240
CONFIG_BT_RX_STACK_SIZE=4096
CONFIG_BT_HCI_TX_STACK_SIZE=4096

CONFIG_BT_SETTINGS=y
CONFIG_FLASH=y
CONFIG_FLASH_PAGE_LAYOUT=y
CONFIG_FLASH_MAP=y
#CONFIG_FCB=y
CONFIG_NVS=y
CONFIG_SETTINGS=y
#CONFIG_SETTINGS_FCB=y
CONFIG_SETTINGS_NVS=y

CONFIG_BT_OBSERVER=y
CONFIG_BT_BROADCASTER=y
CONFIG_BT_CTLR_DUP_FILTER_LEN=0
CONFIG_BT_CTLR_LE_ENC=n
CONFIG_BT_CTLR_LE_PING=n
CONFIG_BT_DATA_LEN_UPDATE=n
CONFIG_BT_PHY_UPDATE=n
CONFIG_BT_CTLR_CHAN_SEL_2=n
CONFIG_BT_CTLR_MIN_USED_CHAN=n
CONFIG_BT_CTLR_ADV_EXT=n
CONFIG_BT_CTLR_PRIVACY=n

CONFIG_BT_PERIPHERAL=y


CONFIG_BT=y
CONFIG_BT_CENTRAL=y
CONFIG_BT_TINYCRYPT_ECC=y
CONFIG_BT_RX_BUF_COUNT=30
CONFIG_BT_L2CAP_TX_MTU=69
CONFIG_BT_L2CAP_RX_MTU=69
CONFIG_BT_L2CAP_TX_BUF_COUNT=5

CONFIG_BT_MESH=y
#CONFIG_FIELDSIGHT_NODE=y
CONFIG_BT_MESH_RELAY=n
#CONFIG_BT_MESH_LOW_POWER=n
#CONFIG_BT_MESH_FRIEND=y
#CONFIG_BT_MESH_FRIEND_QUEUE_SIZE=16
#CONFIG_BT_CTLR_ADVANCED_FEATURES=y
#CONFIG_BT_MESH_LPN_RECV_DELAY=150
#CONFIG_BT_MESH_LPN_SCAN_LATENCY=10

CONFIG_BT_MESH_PB_GATT=y
CONFIG_BT_MESH_PB_ADV=y
CONFIG_BT_MESH_GATT_PROXY=y

#CONFIG_BT_MESH_LPN_SCAN_LATENCY=30
#CONFIG_BT_MESH_LPN_RECV_DELAY=40
#CONFIG_BT_MESH_LPN_POLL_TIMEOUT=300

CONFIG_BT_MESH_SUBNET_COUNT=2
CONFIG_BT_MESH_APP_KEY_COUNT=2
CONFIG_BT_MESH_MODEL_GROUP_COUNT=2
CONFIG_BT_MESH_LABEL_COUNT=3

#CONFIG_BT_MESH_IV_UPDATE_TEST=y

#CONFIG_UART_CONSOLE=n
#CONFIG_BT_DEBUG_MONITOR=y
CONFIG_BT_DEBUG_LOG=y

CONFIG_BT_MESH_DEBUG=y
#CONFIG_BT_MESH_DEBUG_PROV=y
#CONFIG_BT_MESH_DEBUG_PROXY=y
#CONFIG_BT_MESH_DEBUG_BEACON=y
#CONFIG_BT_MESH_DEBUG_NET=y
#CONFIG_BT_MESH_DEBUG_TRANS=y
#CONFIG_BT_MESH_DEBUG_SETTINGS=y
#CONFIG_BT_MESH_DEBUG_LOW_POWER=y
#CONFIG_BT_MESH_DEBUG_FRIEND=y
#CONFIG_BT_MESH_DEBUG_MODEL=y
#CONFIG_BT_MESH_DEBUG_ACCESS=y
#CONFIG_BT_MESH_DEBUG_CRYPTO=y
#CONFIG_BT_MESH_DEBUG_ADV=y
#CONFIG_BT_MESH_SELF_TEST=y

CONFIG_BT_MESH_CFG_CLI=y

#12*32 = 384 bytes now we can xmit
CONFIG_BT_MESH_ADV_BUF_COUNT=32
#CONFIG_BT_MESH_TX_SEG_MAX=22
#CONFIG_BT_MESH_TX_SEG_MAX=2

#CONFIG_BT_MESH_RX_SDU_MAX=384
#CONFIG_BT_MESH_RX_SDU_MAX=48

#RTT
CONFIG_LOG=y
CONFIG_LOG_RUNTIME_FILTERING=y
CONFIG_LOG_BUFFER_SIZE=7168
CONFIG_SEGGER_RTT_BUFFER_SIZE_UP=7168
CONFIG_LOG_PRINTK=y
CONFIG_LOG_PROCESS_TRIGGER_THRESHOLD=0
CONFIG_LOG_BACKEND_RTT=y
CONFIG_USE_SEGGER_RTT=y
#CONFIG_SEGGER_SYSTEMVIEW=y
CONFIG_COVERAGE=n

CONFIG_PRINTK=y
CONFIG_COUNTER=y
CONFIG_COUNTER_RTC2=y

CONFIG_BT_DEVICE_NAME_DYNAMIC=y

CONFIG_SERIAL=y
CONFIG_UART_ASYNC_API=y
CONFIG_UART_1_NRF_UARTE=y

CONFIG_WDT_LOG_LEVEL_DBG=y
CONFIG_WATCHDOG=y


############ stack-analyzer config #############
#CONFIG_THREAD_NAME=y
#CONFIG_STACK_SIZE_ANALYZER=y
#CONFIG_STACK_SIZE_ANALYZER_AUTO=y
#CONFIG_STACK_SIZE_ANALYZER_RUN_UNLOCKED=y

#CONFIG_HW_STACK_PROTECTION=y

CONFIG_CONSOLE=y
CONFIG_BT_DEBUG_LOG=y
#CONFIG_LOG_BUFFER_SIZE=4096
CONFIG_RTT_CONSOLE=y
CONFIG_LOG_BACKEND_RTT=y
CONFIG_LOG_BACKEND_RTT_MODE_DROP=n
CONFIG_USE_SEGGER_RTT=y
#CONFIG_SEGGER_RTT_BUFFER_SIZE_UP=4096
CONFIG_LOG_BACKEND_SHOW_COLOR=n
CONFIG_LOG_PROCESS_THREAD_STACK_SIZE=1024
CONFIG_LOG_STRDUP_BUF_COUNT=20

CONFIG_LOG_DEFAULT_LEVEL=3
################################################
CONFIG_BT_MESH_CRPL=100
###############################################

CONFIG_BT_MESH_HEALTH_CLI=y

CONFIG_BT_MESH_PROVISIONER=y
CONFIG_BT_MESH_CDB=y
CONFIG_BT_MESH_CDB_NODE_COUNT=100
CONFIG_BT_MESH_CDB_SUBNET_COUNT=3
CONFIG_BT_MESH_CDB_APP_KEY_COUNT=3

CONFIG_BT_MESH_TX_SEG_MSG_COUNT=3
```

## src/main.c
```c
/* main.c - Application main entry point */

#include <zephyr.h>
#include <sys/printk.h>
#include <stdio.h>
#include <stdlib.h>
#include <settings/settings.h>
#include <sys/byteorder.h>
#include <nrf.h>
#include <device.h>
#include <drivers/gpio.h>
#include <bluetooth/bluetooth.h>
#include <bluetooth/conn.h>
#include <bluetooth/l2cap.h>
#include <bluetooth/hci.h>
#include <bluetooth/mesh.h>
#include "app_prov.h"

#define BUTTON_DEBOUNCE_DELAY_MS 250

#define OP_DUMMY_SET BT_MESH_MODEL_OP_2(0x82, 0x2f)

void provisioner_thread(void);
K_THREAD_DEFINE(provisioner_tid, 1024, provisioner_thread, NULL, NULL, NULL, 7, 0, K_NO_WAIT);

static struct gpio_callback button_cb;
static struct device *sw_device;

void dummy_report_set(u8_t cmd);

static void button_pressed(struct device *dev, struct gpio_callback *cb, u32_t pin_pos);


void init_led(const char *port, u32_t pin_num)
{
        struct device *led_device = device_get_binding(port);
        gpio_pin_configure(led_device,
                           pin_num, GPIO_DIR_OUT | GPIO_PUD_PULL_UP);
        gpio_pin_write(led_device, pin_num, 1);
}

void main(void)
{

	printk("AAAAAAAAAAAAAAAAAAAAAAAAA\n");
	sw_device = device_get_binding(DT_GPIO_KEYS_SW0_GPIOS_CONTROLLER);
	gpio_pin_configure(sw_device, DT_GPIO_KEYS_SW0_GPIOS_PIN,
			(GPIO_DIR_IN | GPIO_INT | GPIO_INT_EDGE |
			 GPIO_INT_ACTIVE_LOW | GPIO_PUD_PULL_UP));
#if !CONFIG_BOARD_NRF52840_PCA10059
	gpio_pin_configure(sw_device, DT_GPIO_KEYS_SW1_GPIOS_PIN,
			(GPIO_DIR_IN | GPIO_INT | GPIO_INT_EDGE |
			 GPIO_INT_ACTIVE_LOW | GPIO_PUD_PULL_UP));
	gpio_pin_configure(sw_device, DT_GPIO_KEYS_SW2_GPIOS_PIN,
			(GPIO_DIR_IN | GPIO_INT | GPIO_INT_EDGE |
			 GPIO_INT_ACTIVE_LOW | GPIO_PUD_PULL_UP));
	gpio_pin_configure(sw_device, DT_GPIO_KEYS_SW3_GPIOS_PIN,
			(GPIO_DIR_IN | GPIO_INT | GPIO_INT_EDGE |
			 GPIO_INT_ACTIVE_LOW | GPIO_PUD_PULL_UP));
#endif
	gpio_init_callback(&button_cb, button_pressed,
			BIT(DT_GPIO_KEYS_SW0_GPIOS_PIN)
#if !CONFIG_BOARD_NRF52840_PCA10059
			| BIT(DT_GPIO_KEYS_SW1_GPIOS_PIN)
			| BIT(DT_GPIO_KEYS_SW2_GPIOS_PIN)
			| BIT(DT_GPIO_KEYS_SW3_GPIOS_PIN)
#endif
		);

	gpio_add_callback(sw_device, &button_cb);
	gpio_pin_enable_callback(sw_device, DT_GPIO_KEYS_SW0_GPIOS_PIN);
#if !CONFIG_BOARD_NRF52840_PCA10059 
	gpio_pin_enable_callback(sw_device, DT_GPIO_KEYS_SW1_GPIOS_PIN);
	gpio_pin_enable_callback(sw_device, DT_GPIO_KEYS_SW2_GPIOS_PIN);
	gpio_pin_enable_callback(sw_device, DT_GPIO_KEYS_SW3_GPIOS_PIN);
#endif

#if CONFIG_BOARD_NRF52840_PCA10059
	init_led(DT_ALIAS_LED2_GPIOS_CONTROLLER, DT_ALIAS_LED2_GPIOS_PIN);
#else
	init_led(DT_ALIAS_LED1_GPIOS_CONTROLLER, DT_ALIAS_LED1_GPIOS_PIN);
#endif
	printk("BBBBBBBBBBBBBBBBBBBBB\n");
	provisioner();
	printk("CCCCCCCCCCCCCCCCCCCCC\n");

}

static uint8_t pin_to_sw(uint32_t pin_pos)
{
	switch (pin_pos) {
	case BIT(DT_GPIO_KEYS_SW0_GPIOS_PIN): return 0;
#if !CONFIG_BOARD_NRF52840_PCA10059 
	case BIT(DT_GPIO_KEYS_SW1_GPIOS_PIN): return 1;
//	case BIT(DT_GPIO_KEYS_SW2_GPIOS_PIN): return 2;
//	case BIT(DT_GPIO_KEYS_SW3_GPIOS_PIN): return 3;
#endif

	default:
		printk("Invalid pin_pos\n");
	}

	printk("No match for GPIO pin 0x%08x\n", pin_pos);

	return 0;
}
static u32_t time, last_time;
static void button_pressed(struct device *dev, struct gpio_callback *cb,
		u32_t pin_pos)
{
	u8_t button;

	time = k_uptime_get_32();

	/* debounce the switch */
	if (time < last_time + BUTTON_DEBOUNCE_DELAY_MS) {
		last_time = time;
		return;
	}

	last_time = time;

	button = pin_to_sw(pin_pos);

	dummy_report_set(button);
}

void dummy_report_set(u8_t cmd)
{
	int ret;

	bt_mesh_model_msg_init(nw_range_mod_pub->msg, OP_DUMMY_SET);
	
	cmd = cmd ? 1 : 0;
	net_buf_simple_add_u8(nw_range_mod_pub->msg, cmd); //cmd = 0 to stop and 1 to start the dummy report.


	ret = bt_mesh_model_publish(nw_range_mod_cli);

	if (ret) {
		printk("\nmsg publish failed, ERR = %d\n", ret);
		return;
	}

	if (cmd)
		printk("GW:Start dummy report\n");
	else
		printk("GW:Stop dummy report\n");

}

void provisioner_thread_set(bool onoff)
{
        if (onoff)
                k_thread_resume(provisioner_tid);
        else
                k_thread_suspend(provisioner_tid);
}
```

## src/app_prov.c
```c
#include "app_prov.h"
#include <sys/printk.h>
#include <settings/settings.h>
#include <bluetooth/bluetooth.h>
#include <bluetooth/mesh.h>

#define APP_NAME "GW"

static const u16_t net_idx;
static u16_t app_idx;

u8_t dev_uuid[16] = {0xaa, 0xcc};
const struct bt_mesh_prov prov;

bool node_provisioned;

struct bt_mesh_model *nw_range_mod_cli = NULL;
struct bt_mesh_model_pub *nw_range_mod_pub = NULL;
struct bt_mesh_model *cfg_mod_cli = NULL;
struct bt_mesh_model_pub *cfg_mod_pub = NULL;

u16_t self_addr = 0x0001;
static u16_t node_addr;
static u8_t node_uuid[16];


K_SEM_DEFINE(sem_unprov_beacon, 0, 1);
K_SEM_DEFINE(sem_node_added, 0, 1);

static void prov_complete(u16_t net_idx, u16_t addr);
static  void prov_reset(void);
static void unprovisioned_beacon(u8_t uuid[16],
				 bt_mesh_prov_oob_info_t oob_info,
				 u32_t *uri_hash);
static void node_added(u16_t net_idx, u8_t uuid[16], u16_t addr, u8_t num_elem);

static struct bt_mesh_cfg_srv cfg_srv = {
	.relay = BT_MESH_RELAY_DISABLED,
	.beacon = BT_MESH_BEACON_DISABLED,
#if defined(CONFIG_BT_MESH_FRIEND)
	.frnd = BT_MESH_FRIEND_ENABLED,
#else
	.frnd = BT_MESH_FRIEND_NOT_SUPPORTED,
#endif
#if defined(CONFIG_BT_MESH_GATT_PROXY)
	.gatt_proxy = BT_MESH_GATT_PROXY_ENABLED,
#else
	.gatt_proxy = BT_MESH_GATT_PROXY_NOT_SUPPORTED,
#endif
	.default_ttl = 7,

	/* 3 transmissions with 20ms interval */
	.net_transmit = BT_MESH_TRANSMIT(2, 20),
	.relay_retransmit = BT_MESH_TRANSMIT(2, 20),
	//.hb_sub.func = heartbeat,
};
static struct bt_mesh_cfg_cli cfg_cli = {
};

BT_MESH_MODEL_PUB_DEFINE(gen_level_pub_cli, NULL, 9/*max msg size*/ + 2/*opcode side*/);

void health_current_status(struct bt_mesh_health_cli *cli, u16_t addr,
				  u8_t test_id, u16_t cid, u8_t *faults,
				  size_t fault_count);

struct bt_mesh_model root_models[] = {
	BT_MESH_MODEL_CFG_SRV(&cfg_srv),
	BT_MESH_MODEL_CFG_CLI(&cfg_cli),
	BT_MESH_MODEL(BT_MESH_MODEL_ID_GEN_LEVEL_CLI, NULL, &gen_level_pub_cli, NULL),
};

struct bt_mesh_elem elements[] = {
	BT_MESH_ELEM(0, root_models, BT_MESH_MODEL_NONE),
};

struct net_st net = {
        .local = BT_MESH_ADDR_UNASSIGNED,
        .dst = BT_MESH_ADDR_UNASSIGNED,
};

const struct bt_mesh_prov prov = {
	.uuid = dev_uuid,
	.complete = prov_complete,
	.reset = prov_reset,
        .unprovisioned_beacon = unprovisioned_beacon,
        .node_added = node_added,
};

const struct bt_mesh_comp comp = {
	.cid = BT_COMP_ID_LF,
	.elem = elements,
	.elem_count = ARRAY_SIZE(elements),
};

void bt_ready(int err)
{

	if (err) {
		printk(APP_NAME"%s: Bluetooth init failed (err %d)\n", __func__, err);
		return;
	}

	printk(APP_NAME"%s:Bluetooth initialized\n", __func__);


	err = bt_mesh_init(&prov, &comp);
	if (err) {
		printk(APP_NAME"%s: Initializing mesh failed (err %d)\n", __func__, err);
		return;
	}

	if (IS_ENABLED(CONFIG_BT_SETTINGS)) {
		settings_load();
	}

	nw_range_mod_cli = &root_models[ARRAY_SIZE(root_models)-1];
	nw_range_mod_pub = nw_range_mod_cli->pub;
	///////////////////////////////////////////////////////////////////////////
	nw_range_mod_pub->mod = nw_range_mod_cli;
	nw_range_mod_pub->addr = 0x0002;
	nw_range_mod_pub->key = 0; 
	nw_range_mod_pub->cred = false;
	nw_range_mod_pub->ttl = 7;
	nw_range_mod_pub->period = 0;
	nw_range_mod_pub->retransmit = 0;
	/////////////////////////////////////////////////////////////////////////////

	provisioner_thread_set(1);

	err = bt_set_name("Node-A");
	if(err)
		printk("bt_set_name failed, err=%d\n", err);

	printk(APP_NAME"%s: Mesh initialized\n", __func__);
}


static void setup_cdb(void)
{
	struct bt_mesh_cdb_app_key *key;

	key = bt_mesh_cdb_app_key_alloc(net_idx, app_idx);
	if (key == NULL) {
		printk("Failed to allocate app-key 0x%04x\n", app_idx);
		return;
	}

	bt_rand(key->keys[0].app_key, 16);

	if (IS_ENABLED(CONFIG_BT_SETTINGS)) {
		bt_mesh_cdb_app_key_store(key);
	}
}

static void configure_self(struct bt_mesh_cdb_node *self)
{
	struct bt_mesh_cdb_app_key *key;
	int err;
	u8_t status;

	printk("Configuring self...\n");

	key = bt_mesh_cdb_app_key_get(app_idx);
	if (key == NULL) {
		printk("No app-key 0x%04x\n", app_idx);
		return;
	}

	/* Add Application Key */
	err = bt_mesh_cfg_app_key_add(self->net_idx, self->addr, self->net_idx,
				      app_idx, key->keys[0].app_key, NULL);
	if (err < 0) {
		printk("Failed to add app-key (err %d)\n", err);
		return;
	}

	err = bt_mesh_cfg_mod_app_bind(self->net_idx, self->addr, self->addr, app_idx, \
			BT_MESH_MODEL_ID_GEN_LEVEL_CLI, NULL);
	if (err < 0) {
		printk("%s:bt_mesh_cfg_mod_app_bind ERR (%d)\n", __func__, err);
		return;
	}
#if 0 	
	struct bt_mesh_cfg_mod_pub pub;
        pub.addr = 0xc001;
        pub.app_idx = key->app_idx;
        pub.cred_flag = false;
        pub.ttl = 7;
        //pub.period = BT_MESH_PUB_PERIOD_10SEC(1);
        pub.period = 0;
        pub.transmit = 0;

        err = bt_mesh_cfg_mod_pub_set(net_idx, self->addr, self->addr,
                                      BT_MESH_MODEL_ID_GEN_LEVEL_CLI, &pub,
                                      &status);
        if (err < 0) {
                printk("mod_pub_set.. %d, %d\n", err, status);
                return;
        }
#endif
	
	atomic_set_bit(self->flags, BT_MESH_CDB_NODE_CONFIGURED);

        if (IS_ENABLED(CONFIG_BT_SETTINGS)) {
                bt_mesh_cdb_node_store(self);
        }

	printk("Configuration complete\n");
}

static void configure_node(struct bt_mesh_cdb_node *node)
{
	struct bt_mesh_cdb_app_key *key;
	int err;

	printk("Configuring node 0x%04x...\n", node->addr);

	key = bt_mesh_cdb_app_key_get(app_idx);
	if (key == NULL) {
		printk("No app-key 0x%04x\n", app_idx);
		return;
	}

	/* Add Application Key */
	err = bt_mesh_cfg_app_key_add(net_idx, node->addr, net_idx, app_idx,
				      key->keys[0].app_key, NULL);
	if (err < 0) {
		printk("Failed to add app-key (err %d)\n", err);
		return;
	}

	err = bt_mesh_cfg_mod_app_bind(net_idx, node->addr, node->addr, app_idx, \
			BT_MESH_MODEL_ID_GEN_LEVEL_SRV, NULL);
	if (err < 0) {
		printk("%s:bt_mesh_cfg_mod_app_bind ERR (%d)\n", __func__, err);
		return;
	}
	
	 bt_mesh_cfg_mod_sub_add(net_idx, node->addr, node->addr, 0xc001, \
                        BT_MESH_MODEL_ID_GEN_LEVEL_SRV, NULL);


	atomic_set_bit(node->flags, BT_MESH_CDB_NODE_CONFIGURED);

        if (IS_ENABLED(CONFIG_BT_SETTINGS)) {
                bt_mesh_cdb_node_store(node);
        }

	printk("Configuration complete\n");
}

void unprovisioned_beacon(u8_t uuid[16],
				 bt_mesh_prov_oob_info_t oob_info,
				 u32_t *uri_hash)
{
	memcpy(node_uuid, uuid, 16);
	k_sem_give(&sem_unprov_beacon);
}

void node_added(u16_t net_idx, u8_t uuid[16], u16_t addr, u8_t num_elem)
{

	node_addr = addr;

	k_sem_give(&sem_node_added);
}

static int zephyr_provisioner_init(void)
{
	u8_t net_key[16], dev_key[16];
	int err;

	printk("FFFFFFFFFFFFFFFFFFFFF\n");
	bt_rand(net_key, 16);
	printk("GGGGGGGGGGGGGGGGGGGGG\n");
	err = bt_mesh_cdb_create(net_key);
	printk("HHHHHHHHHHHHHHHHHHHHHH\n");
	if (err == -EALREADY) {
		printk("Using stored CDB\n");
	} else if (err) {
		printk("Failed to create CDB (err %d)\n", err);
		return err;
	} else {
		printk("Created CDB\n");
		setup_cdb();
	}

	printk("IIIIIIIIIIIIIIIIIIIIIII\n");
	bt_rand(dev_key, 16);

	err = bt_mesh_provision(net_key, BT_MESH_NET_PRIMARY, 0, 0, self_addr,
				dev_key);
	if (err == -EALREADY) {
		printk("Using stored settings\n");
	} else if (err) {
		printk("%s:Provisioning failed (err %d)\n", __func__, err);
		return err;
	} else {
		printk("Provisioning completed\n");
	}
	printk("JJJJJJJJJJJJJJJJJJJJJJJJ\n");

	return 0;
}

static u8_t check_unconfigured(struct bt_mesh_cdb_node *node, void *data)
{
	if (!atomic_test_bit(node->flags, BT_MESH_CDB_NODE_CONFIGURED)) {
		if (node->addr == self_addr) {
			configure_self(node);
		} else {
			configure_node(node);
		}
	}

	return BT_MESH_CDB_ITER_CONTINUE;
}


void provisioner(void)
{
	char uuid_hex_str[32 + 1];
	int err;

	err = bt_enable(bt_ready);
	if (err) {
		printk("Bluetooth init failed (err %d)\n", err);
	}

	printk("DDDDDDDDDDDDDDDDDDDDDDDDDD\n");
	zephyr_provisioner_init();
	printk("EEEEEEEEEEEEEEEEEEEEEEEEEEE\n");
	while (1) {
		k_sem_reset(&sem_unprov_beacon);
		k_sem_reset(&sem_node_added);
		bt_mesh_cdb_node_foreach(check_unconfigured, NULL);
		#if 0
		bt_mesh_cdb_node_foreach(list_nodes, NULL);
		#endif
		printk("Waiting for unprovisioned beacon...\n");
		err = k_sem_take(&sem_unprov_beacon, K_SECONDS(10));
		if (err == -EAGAIN) {
			continue;
		}

		bin2hex(node_uuid, 16, uuid_hex_str, sizeof(uuid_hex_str));

		printk("Provisioning %s\n", uuid_hex_str);
		err = bt_mesh_provision_adv(node_uuid, net_idx, 0, 0);
		if (err < 0) {
			printk("%s:Provisioning failed (err %d)\n", __func__, err);
			continue;
		}

		printk("Waiting for node to be added...\n");
		err = k_sem_take(&sem_node_added, K_SECONDS(10));
		if (err == -EAGAIN) {
			printk("Timeout waiting for node to be added\n");
			continue;
		}

		printk("Added node 0x%04x\n", node_addr);
	}
}

static void prov_complete(u16_t net_idx, u16_t addr)
{
	struct bt_mesh_elem *ele = &elements[0];

	printk(APP_NAME"%s\n", __func__);
	
	net.local = addr;
        net.net_idx = net_idx,
        net.dst = addr;
	
	self_addr = ele->addr;
	printk("GW_ADDR = 0x%04x\n", addr);
	node_provisioned = 1;
}

static void prov_reset(void)
{
	bt_mesh_prov_enable(BT_MESH_PROV_ADV | BT_MESH_PROV_GATT);
}

u16_t get_element_addr(u8_t ele_num)
{
	struct bt_mesh_elem *ele = &elements[0];

	return ele->addr;
}

void provisioner(void);
void provisioner_thread(void)
{
	provisioner_thread_set(0);
	self_addr = 0x0001;
	provisioner();
}
```

## src/app_prov.h
```c
#ifndef _APP_PROV_H_
#define _APP_PROV_H_

#include <zephyr.h>
#include <sys/printk.h>
#include <stdio.h>
#include <settings/settings.h>
#include <sys/byteorder.h>
#include <nrf.h>
#include <device.h>
#include <drivers/gpio.h>
#include <bluetooth/bluetooth.h>
#include <bluetooth/conn.h>
#include <bluetooth/l2cap.h>
#include <bluetooth/hci.h>
#include <bluetooth/mesh.h>
#include <drivers/counter.h>

#define CONFIG_BT_MESH_ZEPHYR_PROVISION true
#define CONFIG_BT_MESH_SELF_PROVISION false

#if CONFIG_BT_MESH_ZEPHYR_PROVISION
	#define CONFIG_BT_MESH_SELF_PROVISION false
	#define CONFIG_BT_MESH_APP_PROVISION false
#elif CONFIG_BT_MESH_SELF_PROVISION
	#define CONFIG_BT_MESH_APP_PROVISION false
#else
	#define CONFIG_BT_MESH_APP_PROVISION true
#endif

extern u8_t dev_uuid[16];
extern const struct bt_mesh_prov prov;
extern u16_t local_node_addr;
extern bool node_provisioned;

struct net_st {
        u16_t local;
        u16_t dst;
        u16_t net_idx;
        u16_t app_idx;
};
extern struct net_st net;

extern struct bt_mesh_model *nw_range_mod_cli;
extern struct bt_mesh_model_pub *nw_range_mod_pub;

int config_node_relay(u16_t node_addr, u8_t new_relay, u8_t new_transmit, u8_t *status, u8_t *transmit);

#endif /* _APP_PROV_H_ */
```

## src/circular_buffer.c
```c
#include <fieldsightlib.h>
#include <stdlib.h>
#include <stdint.h>
#include <stddef.h>
#include <assert.h>

#include "circular_buffer.h"

static void advance_pointer(cbuf_handle_t cbuf)
{
	assert(cbuf);

	if(cbuf->full)
    {
        cbuf->tail = (cbuf->tail + 1) % cbuf->max;
    }

	cbuf->head = (cbuf->head + 1) % cbuf->max;

	// We mark full because we will advance tail on the next time around
	cbuf->full = (cbuf->head == cbuf->tail);
}

static void retreat_pointer(cbuf_handle_t cbuf)
{
	assert(cbuf);

	cbuf->full = false;
	cbuf->tail = (cbuf->tail + 1) % cbuf->max;
}

cbuf_handle_t circular_buf_init(struct circular_buf_t *cbuf, uint8_t* buffer, size_t size)
{
	assert(buffer && size);
	assert(cbuf);

	cbuf->buffer = buffer;
	cbuf->max = size;
	circular_buf_reset(cbuf);

	assert(circular_buf_empty(cbuf));

	return cbuf;
}

#if 0
void circular_buf_free(cbuf_handle_t cbuf)
{
	assert(cbuf);
	free(cbuf);
}
#endif
void circular_buf_reset(cbuf_handle_t cbuf)
{
    assert(cbuf);

    cbuf->head = 0;
    cbuf->tail = 0;
    cbuf->full = false;
}

size_t circular_buf_size(cbuf_handle_t cbuf)
{
	assert(cbuf);

	size_t size = cbuf->max;

	if(!cbuf->full)
	{
		if(cbuf->head >= cbuf->tail)
		{
			size = (cbuf->head - cbuf->tail);
		}
		else
		{
			size = (cbuf->max + cbuf->head - cbuf->tail);
		}

	}

	return size;
}
size_t circular_buf_avail_bytes(cbuf_handle_t cbuf)
{
	return cbuf->max - circular_buf_size(cbuf);
}
size_t circular_buf_capacity(cbuf_handle_t cbuf)
{
	assert(cbuf);

	return cbuf->max;
}

K_SEM_DEFINE(cbuf_put_sem,1,1);
int circular_buf_put(cbuf_handle_t cbuf, uint8_t *data, uint8_t len)
{
	uint16_t i;
	size_t avail = circular_buf_avail_bytes(cbuf);

		if(avail < len)
			return -1;
	k_sem_take(&cbuf_put_sem, K_FOREVER);	
	for (i = 0; i < len; ++i) {
		cbuf->buffer[cbuf->head] = data[i];
		advance_pointer(cbuf);
	}
	k_sem_give(&cbuf_put_sem);
	return 0;
}

K_SEM_DEFINE(cbuf_get_sem, 1, 1);
int circular_buf_get(cbuf_handle_t cbuf, uint8_t * data)
{
	int r = -1;

	k_sem_take(&cbuf_get_sem, K_FOREVER);	
	if(!circular_buf_empty(cbuf))
	{
		*data = cbuf->buffer[cbuf->tail];
		retreat_pointer(cbuf);

		r = 0;
	}
	k_sem_give(&cbuf_get_sem);

	return r;
}

bool circular_buf_empty(cbuf_handle_t cbuf)
{
	assert(cbuf);

    return (!cbuf->full && (cbuf->head == cbuf->tail));
}

bool circular_buf_full(cbuf_handle_t cbuf)
{
	assert(cbuf);

    return cbuf->full;
}
```

## src/circular_buffer.h
```c
#ifndef CIRCULAR_BUFFER_H_
#define CIRCULAR_BUFFER_H_

#include <stdbool.h>

/// Opaque circular buffer structure
typedef struct circular_buf_t circular_buf_t;

/// Handle type, the way users interact with the API
typedef circular_buf_t* cbuf_handle_t;

/// Pass in a storage buffer and size, returns a circular buffer handle
/// Requires: buffer is not NULL, size > 0
/// Ensures: cbuf has been created and is returned in an empty state
cbuf_handle_t circular_buf_init(struct circular_buf_t *cbuf, uint8_t* buffer, size_t size);
//cbuf_handle_t circular_buf_init(uint8_t* buffer, size_t size);

/// Free a circular buffer structure
/// Requires: cbuf is valid and created by circular_buf_init
/// Does not free data buffer; owner is responsible for that
void circular_buf_free(cbuf_handle_t cbuf);

/// Reset the circular buffer to empty, head == tail. Data not cleared
/// Requires: cbuf is valid and created by circular_buf_init
void circular_buf_reset(cbuf_handle_t cbuf);

/// Put version 1 continues to add data if the buffer is full
/// Old data is overwritten
/// Requires: cbuf is valid and created by circular_buf_init
int circular_buf_put(cbuf_handle_t cbuf, uint8_t *data, uint8_t len);
//void circular_buf_put(cbuf_handle_t cbuf, uint8_t *data, uint8_t len);

/// Put Version 2 rejects new data if the buffer is full
/// Requires: cbuf is valid and created by circular_buf_init
/// Returns 0 on success, -1 if buffer is full
int circular_buf_put2(cbuf_handle_t cbuf, uint8_t data);

/// Retrieve a value from the buffer
/// Requires: cbuf is valid and created by circular_buf_init
/// Returns 0 on success, -1 if the buffer is empty
int circular_buf_get(cbuf_handle_t cbuf, uint8_t * data);

/// CHecks if the buffer is empty
/// Requires: cbuf is valid and created by circular_buf_init
/// Returns true if the buffer is empty
bool circular_buf_empty(cbuf_handle_t cbuf);

/// Checks if the buffer is full
/// Requires: cbuf is valid and created by circular_buf_init
/// Returns true if the buffer is full
bool circular_buf_full(cbuf_handle_t cbuf);

/// Check the capacity of the buffer
/// Requires: cbuf is valid and created by circular_buf_init
/// Returns the maximum capacity of the buffer
size_t circular_buf_capacity(cbuf_handle_t cbuf);

/// Check the number of elements stored in the buffer
/// Requires: cbuf is valid and created by circular_buf_init
/// Returns the current number of elements in the buffer
size_t circular_buf_size(cbuf_handle_t cbuf);

// The definition of our circular buffer structure is hidden from the user
struct circular_buf_t {
	uint8_t * buffer;
	size_t head;
	size_t tail;
	size_t max; //of the buffer
	bool full;
};
//TODO: int circular_buf_get_range(circular_buf_t cbuf, uint8_t *data, size_t len);
//TODO: int circular_buf_put_range(circular_buf_t cbuf, uint8_t * data, size_t len);

#endif //CIRCULAR_BUFFER_H_
```

## src/circular_buffer_test.c
```c
#include <stdio.h>
#include <stdlib.h>
#include <stdint.h>
#include <stddef.h>
#include <stdbool.h>
#include <assert.h>

#include "circular_buffer.h"

#define EXAMPLE_BUFFER_SIZE 10
uint8_t buffer[EXAMPLE_BUFFER_SIZE];


void print_buffer_status(cbuf_handle_t cbuf);

int main(void)
{
//	uint8_t * buffer  = malloc(EXAMPLE_BUFFER_SIZE * sizeof(uint8_t));

	printf("\n=== C Circular Buffer Check ===\n");

	cbuf_handle_t cbuf = circular_buf_init(buffer, EXAMPLE_BUFFER_SIZE);

	printf("Buffer initialized. ");
	print_buffer_status(cbuf);

	printf("\n******\nAdding %d values\n", EXAMPLE_BUFFER_SIZE - 1);
	for(uint8_t i = 0; i < (EXAMPLE_BUFFER_SIZE - 1); i++)
	{
		circular_buf_put(cbuf, i);
		printf("Added %u, Size now: %zu\n", i, circular_buf_size(cbuf));
	}

	print_buffer_status(cbuf);

	printf("\n******\nAdding %d values\n", EXAMPLE_BUFFER_SIZE);
	for(uint8_t i = 0; i < EXAMPLE_BUFFER_SIZE; i++)
	{
		circular_buf_put(cbuf, i);
		printf("Added %u, Size now: %zu\n", i, circular_buf_size(cbuf));
	}

	print_buffer_status(cbuf);

	printf("\n******\nReading back values: ");
	while(!circular_buf_empty(cbuf))
	{
		uint8_t data;
		circular_buf_get(cbuf, &data);
		printf("%u ", data);
	}
	printf("\n");

	print_buffer_status(cbuf);

	printf("\n******\nAdding %d values\n", EXAMPLE_BUFFER_SIZE + 5);
//	for(uint8_t i = 0; i < EXAMPLE_BUFFER_SIZE + 5; i++)
//	{
		circular_buf_put(cbuf, i, EXAMPLE_BUFFER_SIZE);
		printf("Added %u, Size now: %zu\n", i, circular_buf_size(cbuf));
//	}

	print_buffer_status(cbuf);

	printf("\n******\nReading back values: ");
	while(!circular_buf_empty(cbuf))
	{
		uint8_t data;
		circular_buf_get(cbuf, &data);
		printf("%u ", data);
	}
	printf("\n");

#if 0
	printf("\n******\nAdding %d values using non-overwrite version\n", EXAMPLE_BUFFER_SIZE + 5);
	for(uint8_t i = 0; i < EXAMPLE_BUFFER_SIZE + 5; i++)
	{
		circular_buf_put2(cbuf, i);
	}
#endif
	print_buffer_status(cbuf);

	printf("\n******\nReading back values: ");
	while(!circular_buf_empty(cbuf))
	{
		uint8_t data;
		circular_buf_get(cbuf, &data);
		printf("%u ", data);
	}
	printf("\n");

	free(buffer);
	circular_buf_free(cbuf);

	return 0;
}

void print_buffer_status(cbuf_handle_t cbuf)
{
	printf("Full: %d, empty: %d, size: %zu\n",
		circular_buf_full(cbuf),
		circular_buf_empty(cbuf),
		circular_buf_size(cbuf));
}
```

## src/gsm_uart.h
```c
/*
 * Copyright (c) 2019 Nordic Semiconductor ASA
 *
 * SPDX-License-Identifier: Apache-2.0
 */

/**
 * @file
 * @brief UART cases header file
 *
 * Header file for UART cases
 */

#ifndef __TEST_UART_H__
#define __TEST_UART_H__

#include <drivers/uart.h>
//#include <ztest.h>

/* RX and TX pins have to be connected together*/

#if defined(CONFIG_BOARD_NRF52840_PCA10056)
#define UART_DEVICE_NAME DT_UART_0_NAME
#elif defined(CONFIG_BOARD_NRF9160_PCA10090)
#define UART_DEVICE_NAME DT_UART_1_NAME
#else
#define UART_DEVICE_NAME CONFIG_UART_CONSOLE_ON_DEV_NAME
#endif

void test_single_read(void);
void test_chained_read(void);
void test_double_buffer(void);
void test_read_abort(void);
void test_write_abort(void);
void test_chained_write(void);

#endif /* __TEST_UART_H__ */
```

## src/user_cfg.h
```c
#ifndef USER_CFG_H
#define USER_CFG_H

static struct bt_mesh_cfg_srv cfg_srv = {
	.relay = BT_MESH_RELAY_DISABLED,
	.beacon = BT_MESH_BEACON_DISABLED,
#if defined(CONFIG_BT_MESH_FRIEND)
	.frnd = BT_MESH_FRIEND_ENABLED,
#else
	.frnd = BT_MESH_FRIEND_NOT_SUPPORTED,
#endif
#if defined(CONFIG_BT_MESH_GATT_PROXY)
	.gatt_proxy = BT_MESH_GATT_PROXY_ENABLED,
#else
	.gatt_proxy = BT_MESH_GATT_PROXY_NOT_SUPPORTED,
#endif
	.default_ttl = 7,

	/* 3 transmissions with 20ms interval */
	.net_transmit = BT_MESH_TRANSMIT(2, 20),
	.relay_retransmit = BT_MESH_TRANSMIT(2, 20),
//	.hb_sub.func = heartbeat,
};

#endif /*USER_CFG_H*/
```
