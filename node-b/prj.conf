## prj.conf
```kconfig
#CONFIG_INIT_STACKS=y
CONFIG_MAIN_STACK_SIZE=512
CONFIG_SYSTEM_WORKQUEUE_STACK_SIZE=2048 


CONFIG_BT_SETTINGS=y
CONFIG_FLASH=y
CONFIG_FLASH_PAGE_LAYOUT=y
CONFIG_FLASH_MAP=y
#CONFIG_FCB=y
CONFIG_NVS=y
CONFIG_SETTINGS=y
#CONFIG_SETTINGS_FCB=y
CONFIG_SETTINGS_NVS=y

CONFIG_BT_OBSERVER=y
CONFIG_BT_BROADCASTER=y
CONFIG_BT_CTLR_DUP_FILTER_LEN=0
CONFIG_BT_CTLR_LE_ENC=n
CONFIG_BT_CTLR_LE_PING=n
CONFIG_BT_DATA_LEN_UPDATE=n
CONFIG_BT_PHY_UPDATE=n
CONFIG_BT_CTLR_CHAN_SEL_2=n
CONFIG_BT_CTLR_MIN_USED_CHAN=n
CONFIG_BT_CTLR_ADV_EXT=n
CONFIG_BT_CTLR_PRIVACY=n

CONFIG_BT_PERIPHERAL=y


CONFIG_BT=y
CONFIG_BT_CENTRAL=y
CONFIG_BT_TINYCRYPT_ECC=y
CONFIG_BT_RX_BUF_COUNT=30
CONFIG_BT_L2CAP_TX_MTU=69
CONFIG_BT_L2CAP_RX_MTU=69
CONFIG_BT_L2CAP_TX_BUF_COUNT=5

CONFIG_BT_MESH=y
CONFIG_BT_MESH_RELAY=y
#CONFIG_BT_MESH_LOW_POWER=y
#CONFIG_BT_CTLR_ADVANCED_FEATURES=y
#CONFIG_BT_MESH_LPN_RECV_DELAY=150
#CONFIG_BT_MESH_LPN_SCAN_LATENCY=10
#CONFIG_BT_MESH_FRIEND=n
#CONFIG_BT_MESH_FRIEND_QUEUE_SIZE=16

CONFIG_BT_MESH_PB_GATT=y
CONFIG_BT_MESH_PB_ADV=y
CONFIG_BT_MESH_GATT_PROXY=y

#CONFIG_BT_MESH_LPN_SCAN_LATENCY=30
#CONFIG_BT_MESH_LPN_RECV_DELAY=40
#CONFIG_BT_MESH_LPN_POLL_TIMEOUT=300

CONFIG_BT_MESH_SUBNET_COUNT=2
CONFIG_BT_MESH_APP_KEY_COUNT=2
CONFIG_BT_MESH_MODEL_GROUP_COUNT=2
CONFIG_BT_MESH_LABEL_COUNT=3

#CONFIG_BT_MESH_IV_UPDATE_TEST=y

#CONFIG_UART_CONSOLE=n
#CONFIG_BT_DEBUG_MONITOR=y
CONFIG_BT_DEBUG_LOG=y

CONFIG_BT_MESH_DEBUG=y
#CONFIG_BT_MESH_DEBUG_PROV=y
#CONFIG_BT_MESH_DEBUG_PROXY=y
#CONFIG_BT_MESH_DEBUG_BEACON=y
#CONFIG_BT_MESH_DEBUG_NET=y
#CONFIG_BT_MESH_DEBUG_TRANS=y
#CONFIG_BT_MESH_DEBUG_SETTINGS=y
#CONFIG_BT_MESH_DEBUG_LOW_POWER=y
#CONFIG_BT_MESH_DEBUG_FRIEND=y
#CONFIG_BT_MESH_DEBUG_MODEL=y
#CONFIG_BT_MESH_DEBUG_ACCESS=y
#CONFIG_BT_MESH_DEBUG_CRYPTO=y
#CONFIG_BT_MESH_DEBUG_ADV=y
#CONFIG_BT_MESH_SELF_TEST=y

#CONFIG_BT_MESH_CFG_CLI=y

#12*32 = 384 bytes now we can xmit
CONFIG_BT_MESH_ADV_BUF_COUNT=35
CONFIG_BT_MESH_TX_SEG_MAX=22
#CONFIG_BT_MESH_TX_SEG_MAX=2

#CONFIG_BT_MESH_RX_SDU_MAX=384
#CONFIG_BT_MESH_RX_SDU_MAX=48

#RTT
CONFIG_LOG=y
CONFIG_LOG_RUNTIME_FILTERING=y
CONFIG_LOG_BUFFER_SIZE=5120
CONFIG_SEGGER_RTT_BUFFER_SIZE_UP=5120
CONFIG_LOG_PRINTK=y
CONFIG_LOG_PROCESS_TRIGGER_THRESHOLD=0
CONFIG_LOG_BACKEND_RTT=y
CONFIG_USE_SEGGER_RTT=y
#CONFIG_SEGGER_SYSTEMVIEW=y
CONFIG_COVERAGE=n

CONFIG_PRINTK=y
#CONFIG_COUNTER=y
#CONFIG_COUNTER_RTC2=y

#CONFIG_WDT_LOG_LEVEL_DBG=y
#CONFIG_WATCHDOG=y

CONFIG_FLASH=y
CONFIG_FLASH_PAGE_LAYOUT=y
CONFIG_MPU_ALLOW_FLASH_WRITE=y

CONFIG_BT_DEVICE_NAME_DYNAMIC=y

#CONFIG_BT_CTLR_JOB_PRIO=1


############ stack-analyzer config #############
#CONFIG_THREAD_NAME=y
#CONFIG_STACK_SIZE_ANALYZER=y
#CONFIG_STACK_SIZE_ANALYZER_AUTO=y
#CONFIG_STACK_SIZE_ANALYZER_RUN_UNLOCKED=y

CONFIG_HW_STACK_PROTECTION=y

CONFIG_CONSOLE=y
CONFIG_BT_DEBUG_LOG=y
#CONFIG_LOG_BUFFER_SIZE=4096
CONFIG_RTT_CONSOLE=y
CONFIG_LOG_BACKEND_RTT=y
CONFIG_LOG_BACKEND_RTT_MODE_DROP=n
CONFIG_USE_SEGGER_RTT=y
#CONFIG_SEGGER_RTT_BUFFER_SIZE_UP=4096
CONFIG_LOG_BACKEND_SHOW_COLOR=n
CONFIG_LOG_PROCESS_THREAD_STACK_SIZE=1024
CONFIG_LOG_STRDUP_BUF_COUNT=20

CONFIG_LOG_DEFAULT_LEVEL=3
################################################
```

## src/main.c
```c
//* main.c - Application main entry point */

/*
 * SPDX-License-Identifier: Apache-2.0
 */

#include <zephyr.h>
#include <sys/printk.h>
#include <stdio.h>
#include <settings/settings.h>
#include <sys/byteorder.h>
#include <nrf.h>
#include <device.h>
#include <drivers/gpio.h>
#include <bluetooth/bluetooth.h>
#include <bluetooth/conn.h>
#include <bluetooth/l2cap.h>
#include <bluetooth/hci.h>
#include <bluetooth/mesh.h>


#include <nrfx/hal/nrf_temp.h>
#include <drivers/flash.h>


#define APP_NAME "Node"

#define OP_DUMMY_SET BT_MESH_MODEL_OP_2(0x82, 0x2f)

static struct bt_mesh_model *mod_cli = NULL;
static struct bt_mesh_model_pub *mod_pub = NULL;

static s8_t die_temperature(void);

static struct bt_mesh_cfg_srv cfg_srv = {
        .relay = BT_MESH_RELAY_ENABLED,
        .beacon = BT_MESH_BEACON_DISABLED,
#if defined(CONFIG_BT_MESH_FRIEND)
        .frnd = BT_MESH_FRIEND_ENABLED,
#else
        .frnd = BT_MESH_FRIEND_NOT_SUPPORTED,
#endif
#if defined(CONFIG_BT_MESH_GATT_PROXY)
        .gatt_proxy = BT_MESH_GATT_PROXY_ENABLED,
#else
        .gatt_proxy = BT_MESH_GATT_PROXY_NOT_SUPPORTED,
#endif
        .default_ttl = 7,

        /* 3 transmissions with 20ms interval */
        .net_transmit = BT_MESH_TRANSMIT(0, 20),
        .relay_retransmit = BT_MESH_TRANSMIT(0, 20),
};

static u8_t dummy_flg;
static void dummy_thread(void);
K_THREAD_DEFINE(dummy_tid, 2048, dummy_thread, NULL, NULL, NULL, 7, 0, K_NO_WAIT);
static void dummy_thread(void)
{
	while (1) {
			k_sleep(K_MSEC(8000));
			printk("flag = %d\n",dummy_flg);
			printf("%s\n", __func__);
			//k_thread_suspend(dummy_tid);
	}
}

static void dummy_set(struct bt_mesh_model *model,
			  struct bt_mesh_msg_ctx *ctx,
			  struct net_buf_simple *buf)
{
	dummy_flg = net_buf_simple_pull_u8(buf);

	if (dummy_flg) {
		printk("WAKEUP:NODE:Start DUMMY report\n");
		k_wakeup(dummy_tid);
		printk("RESUME:NODE:Start DUMMY report\n");
		k_thread_resume(dummy_tid);
	} else {
		printk("SUSPEND:NODE:Stop DUMMY report\n");
		k_thread_suspend(dummy_tid);
	}
}

static const struct bt_mesh_model_op gen_level_srv_op[] = {
        { OP_DUMMY_SET, 0, dummy_set },
        BT_MESH_MODEL_OP_END,
};

static struct bt_mesh_model root_models[] = {
	BT_MESH_MODEL_CFG_SRV(&cfg_srv),
	BT_MESH_MODEL(BT_MESH_MODEL_ID_GEN_LEVEL_SRV, gen_level_srv_op,
			NULL, NULL),

};

static struct bt_mesh_elem elements[] = {
	BT_MESH_ELEM(0, root_models, BT_MESH_MODEL_NONE),
};

static const struct bt_mesh_comp comp = {
	.cid = BT_COMP_ID_LF,
	.elem = elements,
	.elem_count = ARRAY_SIZE(elements),
};

static u16_t node_addr;
static void prov_complete(u16_t net_idx, u16_t addr)
{
	struct bt_mesh_elem *ele = &elements[0];

	printk(APP_NAME"%s\n", __func__);
	//board_prov_complete();
	node_addr = ele->addr;
	printk("NODE_ADDR = 0x%04x\n", node_addr);

}

static void prov_reset(void)
{
	bt_mesh_prov_enable(BT_MESH_PROV_ADV | BT_MESH_PROV_GATT);
}
static const u8_t dev_uuid[16] = { 0xdd, 0xda };

static const struct bt_mesh_prov prov = {
	.uuid = dev_uuid,
	.complete = prov_complete,
	.reset = prov_reset,
};

static void bt_ready(int err)
{
	struct bt_mesh_elem *ele = &elements[0];
	if (err) {
		printk(APP_NAME"%s: Bluetooth init failed (err %d)\n", __func__, err);
		return;
	}

	printk(APP_NAME"%s:Bluetooth initialized\n", __func__);

	//board_init();

	err = bt_mesh_init(&prov, &comp);
	if (err) {
		printk(APP_NAME"%s: Initializing mesh failed (err %d)\n", __func__, err);
		return;
	}

	if (IS_ENABLED(CONFIG_BT_SETTINGS)) {
		settings_load();
	}

	mod_cli = &root_models[ARRAY_SIZE(root_models)-1];
	mod_pub = mod_cli->pub;
	/* This will be a no-op if settings_load() loaded provisioning info */
	err = bt_mesh_prov_enable(BT_MESH_PROV_ADV | BT_MESH_PROV_GATT);
	if (err == -EALREADY) {
		printk("\nUsing stored settings\n");
		ele = &elements[0];
		node_addr = ele->addr;
		printk("NODE_ADDR = 0x%04x\n", node_addr);
	} else {
		printk("\n\nPlease provision the node\n\n");
	}
	
	printk(APP_NAME"%s: Mesh initialized\n", __func__);
	printk("\n....Node....\n");
	err = bt_set_name("Node");
	if(err)
		printk("bt_set_name failed, err=%d\n", err);

}

void main(void)
{       
        
	int err;
	
	k_thread_suspend(dummy_tid);

	err = bt_enable(bt_ready);
	if (err) {
		printk("Bluetooth init failed (err %d)\n", err);
		return;
	}
	
	printk("Bluetooth initialized\n");
}

static s8_t die_temperature(void)
{
        int32_t temp;

        NRF_TEMP->TASKS_START = 1;
        k_sleep(K_MSEC(100));
        temp = (nrf_temp_result_get(NRF_TEMP) / 4);
        NRF_TEMP->TASKS_STOP = 1;

        return temp;
}
```

## src/op_code.h
```c
#ifndef OP_CODE_H
#define OP_CODE_H

#define OP_BTSCAN_REPORT		BT_MESH_MODEL_OP_2(0x82, 0x00)
#define OP_BTSCAN_REPORT_SET		BT_MESH_MODEL_OP_2(0x82, 0x01)
#define OP_BTSCAN_REPORT_GET		BT_MESH_MODEL_OP_2(0x82, 0x02)
#define OP_BTSCAN_REPORT_STATUS		BT_MESH_MODEL_OP_2(0x82, 0x03)
#define OP_BTSCAN_INTERVAL_SET		BT_MESH_MODEL_OP_2(0x82, 0x04)
#define OP_BTSCAN_INTERVAL_GET		BT_MESH_MODEL_OP_2(0x82, 0x05)
#define OP_BTSCAN_INTERVAL_STATUS	BT_MESH_MODEL_OP_2(0x82, 0x06)
#define OP_BTSCAN_FILTER_SET		BT_MESH_MODEL_OP_2(0x82, 0x07)
#define OP_BTSCAN_FILTER_GET		BT_MESH_MODEL_OP_2(0x82, 0x08)
#define OP_BTSCAN_FILTER_STATUS		BT_MESH_MODEL_OP_2(0x82, 0x09)
#define OP_ENVI_REPORT			BT_MESH_MODEL_OP_2(0x82, 0x0a)
#define OP_ENVI_REPORT_SET		BT_MESH_MODEL_OP_2(0x82, 0x0b)
#define OP_ENVI_REPORT_GET		BT_MESH_MODEL_OP_2(0x82, 0x0c)
#define OP_ENVI_REPORT_STATUS		BT_MESH_MODEL_OP_2(0x82, 0x0d)
#define OP_ENVI_INTERVAL_SET		BT_MESH_MODEL_OP_2(0x82, 0x0e)
#define OP_ENVI_INTERVAL_GET		BT_MESH_MODEL_OP_2(0x82, 0x0f)
#define OP_ENVI_INTERVAL_STATUS		BT_MESH_MODEL_OP_2(0x82, 0x10)
#define OP_HEALTH_REPORT_SET		BT_MESH_MODEL_OP_2(0x82, 0x11)
#define OP_HEALTH_REPORT_GET		BT_MESH_MODEL_OP_2(0x82, 0x12)
#define OP_HEALTH_REPORT_STATUS		BT_MESH_MODEL_OP_2(0x82, 0x13)

#endif /*OP_CODE_H*/
```
